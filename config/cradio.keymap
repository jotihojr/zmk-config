/* source keypos definitions */
#include "../zmk-nodefree-config/keypos_def/keypos_34keys.h"

// activate bluetooth
#define CONFIG_WIRELESS 1

// Handedness - RALT as unidode lead
#define OS_UNICODE_LEAD &macro_press &kp RALT
#define OS_UNICODE_TRAIL &macro_release &kp RALT

ZMK_UNICODE_SINGLE(de_euro,  N2, N0, A, C)

/* map Planck's extra keys */
/*
#define X_MT  &none   &none                  // top row, middle
#define X_MM  &none   &none                  // middle row, middle
#define X_MB  &none   &none                  // bottom row, middle
#define X_LH  &none   &kp LGUI &smart_mouse  // thumb row, left
#define X_MH  &none   &none                  // thumb row, middle
#define X_RH  &bs_del U_WH_D   U_WH_U        // thumb row, right
*/

/* source the main keymap */
#include "base.keymap"

// vim: filetype=devicetree
